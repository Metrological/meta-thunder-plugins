## conf/distro/include/thunder-plugins_generic.conf
```bitbake
DISTROOVERRIDES .= ":${DISTRO_CODENAME}"
DISTROOVERRIDES .= ":${DISTRO}"

# PREFERRED_VERSION_wpewebkit = "2.28%"
# PREFERRED_VERSION_libwpe = "1.6.0%"
# PREFERRED_VERSION_wpebackend-rdk = "git%"
# PREFERRED_VERSION_icu = "65.%"
PREFERRED_PROVIDER_virtual/wpebackend = "wpebackend-rdk"

DISTRO_FEATURES:append = " compositor"

# Select packages based on distro name selection
require thunder-plugins_generic_dunfell.conf
require thunder-plugins_generic_kirkstone.conf
require thunder-plugins_generic_scarthgap.conf

# Set thunder permissions based on moudule requirements
require thunder-plugins_permissions.inc
```

## conf/distro/include/thunder-plugins_generic_dunfell.conf
```bitbake
BBMASK:append:dunfell = " meta-thunder-plugins/recipes-graphics/weston/weston_10.%.bbappend"
BBMASK:append:dunfell = " meta-thunder-plugins/recipes-graphics/weston/weston_13.%.bbappend"
```

## conf/distro/include/thunder-plugins_generic_kirkstone.conf
```bitbake
BBMASK:append:kirkstone = " meta-thunder-plugins/recipes-multimedia/gstreamer/gstreamer1.0-omx_1.16.%.bbappend"
BBMASK:append:kirkstone = " meta-thunder-plugins/recipes-multimedia/gstreamer/gstreamer1.0-plugins-bad_1.16.%.bbappend"
BBMASK:append:kirkstone = " meta-thunder-plugins/recipes-multimedia/gstreamer/gstreamer1.0-plugins-base_1.16%.bbappend"
BBMASK:append:kirkstone = " meta-thunder-plugins/recipes-multimedia/gstreamer/gstreamer1.0-plugins-good_1.16.%.bbappend"
BBMASK:append:kirkstone = " meta-thunder-plugins/recipes-multimedia/gstreamer/gstreamer1.0_1.16.%.bbappend"

BBMASK:append:kirkstone = " meta-thunder-plugins/recipes-graphics/weston/weston_8.%.bbappend"
BBMASK:append:kirkstone = " meta-thunder-plugins/recipes-graphics/weston/weston_13.%.bbappend"
```

## conf/distro/include/thunder-plugins_generic_scarthgap.conf
```bitbake
BBMASK:append:scarthgap = " meta-thunder-plugins/recipes-multimedia/gstreamer/gstreamer1.0-omx_1.16.%.bbappend"
BBMASK:append:scarthgap = " meta-thunder-plugins/recipes-multimedia/gstreamer/gstreamer1.0-plugins-bad_1.16.%.bbappend"
BBMASK:append:scarthgap = " meta-thunder-plugins/recipes-multimedia/gstreamer/gstreamer1.0-plugins-base_1.16%.bbappend"
BBMASK:append:scarthgap = " meta-thunder-plugins/recipes-multimedia/gstreamer/gstreamer1.0-plugins-good_1.16.%.bbappend"
BBMASK:append:scarthgap = " meta-thunder-plugins/recipes-multimedia/gstreamer/gstreamer1.0_1.16.%.bbappend"

BBMASK:append:scarthgap = " meta-thunder-plugins/recipes-graphics/weston/weston_8.%.bbappend"
BBMASK:append:scarthgap = " meta-thunder-plugins/recipes-graphics/weston/weston_10.%.bbappend"

BBMASK:append:scarthgap = " meta-thunder-plugins/recipes-graphics/cairo/cairo_1.16.0.bbappend"
```

## conf/distro/include/thunder-plugins_permissions.inc
```bitbake
ROOTFS_POSTPROCESS_COMMAND:append = " update_ocdm_data_path_permissions;"
update_ocdm_data_path_permissions () {
    if [ "${WPEFRAMEWORK_OCDM_GROUP}" != "" ] && [ "${WPEFRAMEWORK_OCDM_SUPER_USER_GROUP}" != "" ]; then
        if [ -d "${IMAGE_ROOTFS}/${WPEFRAMEWORK_INSTALL_PATH}/OCDM" ]; then
            chmod 0550 "${IMAGE_ROOTFS}/${WPEFRAMEWORK_INSTALL_PATH}/OCDM"
            chown -R "${WPEFRAMEWORK_OCDM_SUPER_USER_GROUP}:${WPEFRAMEWORK_OCDM_GROUP}" "${IMAGE_ROOTFS}/${WPEFRAMEWORK_INSTALL_PATH}/OCDM"
        fi
    fi
}

ROOTFS_POSTPROCESS_COMMAND:append = " update_cobalt_data_path_permissions;"
update_cobalt_data_path_permissions () {
    if [ "${WPE_COBALT_USER}" != "" ] && [ "${WPE_COBALT_SUPER_USER_GROUP}" != "" ]; then
        if [ -d "${IMAGE_ROOTFS}/${WPEFRAMEWORK_INSTALL_PATH}/Cobalt" ]; then
            chmod -R 0550 "${IMAGE_ROOTFS}/${WPEFRAMEWORK_INSTALL_PATH}/Cobalt"
            chown -R "${WPE_COBALT_USER}:${WPE_COBALT_SUPER_USER_GROUP}" "${IMAGE_ROOTFS}/${WPEFRAMEWORK_INSTALL_PATH}/Cobalt"
        fi
    fi
}

ROOTFS_POSTPROCESS_COMMAND:append = " update_webkit_data_path_permissions;"
update_webkit_data_path_permissions () {
    if [ "${WPE_WEBKITBROWSER_USER}" != "" ] && [ "${WPE_WEBKITBROWSER_SUPER_USER_GROUP}" != "" ]; then
        if [ -d "${IMAGE_ROOTFS}/${WPEFRAMEWORK_INSTALL_PATH}/WebKitBrowser" ]; then
            chmod -R 0440 "${IMAGE_ROOTFS}/${WPEFRAMEWORK_INSTALL_PATH}/WebKitBrowser"
            chown -R "${WPE_WEBKITBROWSER_USER}:${WPE_WEBKITBROWSER_SUPER_USER_GROUP}" "${IMAGE_ROOTFS}/${WPEFRAMEWORK_INSTALL_PATH}/WebKitBrowser"
        fi
    fi
}
```

## conf/layer.conf
```bitbake
# We have a conf and classes directory, add to BBPATH
BBPATH .= ":${LAYERDIR}"

# We have recipes-* directories, add to BBFILES
BBFILES += "${LAYERDIR}/recipes-*/*/*.bb \
            ${LAYERDIR}/recipes-*/*/*.bbappend"

BBFILE_COLLECTIONS += "meta-thunder-plugins"
BBFILE_PATTERN_meta-thunder-plugins = "^${LAYERDIR}/"
BBFILE_PRIORITY_meta-thunder-plugins = "21"

LAYERDEPENDS_meta-thunder-plugins = "\
    meta-thunder-framework \
"

require distro/include/thunder-plugins_generic.conf

# whitelist faad2 commercial license
LICENSE_FLAGS_ACCEPTED:append = " commercial_gst-plugins-ugly commercial_faad2"
LICENSE_FLAGS_WHITELIST:append:dunfell = " commercial_faad2"

# Block RDK recepices of thunder and WPE webkit 
BBMASK:append:rdk = " /meta-rdk-video/recipes-extended/wpe-framework"
BBMASK:append:rdk = " /meta-rdk-ext/recipes-extended/wpe-webkit"

# Patches are already in RDK
BBMASK:append:rdk = " /meta-thunder-plugins/recipes-graphics/cairo/cairo_%.bbappend"

# Cookie jar patch already in RDK
BBMASK:append:rdk = " /meta-thunder-plugins/recipes-support/libsoup/libsoup-2.4_%.bbappend"

# RDK provides this package
BBMASK:append:rdk = " /meta-thunder-plugins/recipes-support/nghttp2/nghttp2_1.47.0.bb"

LAYERSERIES_COMPAT_meta-thunder-plugins = "dunfell kirkstone scarthgap"
```
